
#include <avr/pgmspace.h>
struct Registro{
byte edad;
byte sexo;
int imc10;
byte actividad;
int calorias;
byte antecedentes;
byte obesidad;
};
const Registro datos[] PROGMEM={
{25,0,225,5,2200,0,0},
{34,1,278,2,2800,1,1},
{19,0,213,6,2000,0,0},
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{55,0,329,0,3500,1,1}

};
const int TOTAL=sizeof(datos)/sizeof(datos[0]);
float W[7]={0,0,0,0,0,0,0};
const float TASA=0.1;
const int MAX_EPOCAS=1000;
void leerRegistro(int i,Registro &r){
memcpy_P(&r,&datos[i],sizeof(Registro));
}
void entradas(Registro r,float X[7]){
X[0]=1;
X[1]=r.edad/100.0;
X[2]=r.sexo;
X[3]=r.imc10/400.0;
X[4]=r.actividad/10.0;
X[5]=r.calorias/4000.0;
X[6]=r.antecedentes;
}
float calcularZ(float X[7]){
float z=0;
for(int j=0;j<7;j++){
z=z+W[j]*X[j];
}
return z;
}
int predecir(float X[7]){
return calcularZ(X)>=0?1:0;
}
void entrenar(){
for(int epoca=1;epoca<=MAX_EPOCAS;epoca++){
int errores=0;
for(int i=0;i<TOTAL;i++){
Registro r;
leerRegistro(i,r);
float X[7];
entradas(r,X);
int error=(int)r.obesidad-predecir(X);
if(error!=0){
for(int j=0;j<7;j++){
W[j]=W[j]+TASA*error*X[j];
}
errores++;
}
}
Serial.print("Epoca ");
Serial.print(epoca);
Serial.print(" - Correcciones: ");
Serial.println(errores);
if(errores==0){
break;
}
}
}
void evaluar(){
int aciertos=0;
for(int i=0;i<TOTAL;i++){
Registro r;
leerRegistro(i,r);
float X[7];
entradas(r,X);
if(predecir(X)==r.obesidad){
aciertos++;
}
}
Serial.println("PESOS FINALES:");
for(int j=0;j<7;j++){
Serial.print("W");
Serial.print(j);
Serial.print(" = ");
Serial.println(W[j],8);
}
Serial.print("Aciertos: ");
Serial.print(aciertos);
Serial.print("/");
Serial.println(TOTAL);
Serial.print("Exactitud: ");
Serial.print(100.0*aciertos/TOTAL,2);
Serial.println("%");
Serial.println("Z=W0+W1*(Edad/100)+W2*Sexo+W3*(IMC/40)+W4*(Actividad/10)+W5*(Calorias/4000)+W6*Antecedentes");
Serial.println("Frontera: Z=0");
Serial.println("Introduzca Edad,Sexo,IMC,Actividad,Calorias,Antecedentes");
Serial.println("Ejemplo: 25,0,22.5,5,2200,0");
}
void setup(){
Serial.begin(9600);
Serial.setTimeout(1000);
Serial.println("PERCEPTRON DE OBESIDAD");
Serial.print("Registros: ");
Serial.println(TOTAL);
entrenar();
evaluar();
}
void loop(){
if(Serial.available()>0){
String linea=Serial.readStringUntil('\n');
linea.trim();
float valores[6];
int inicio=0;
bool valido=true;
for(int i=0;i<6;i++){
int coma=linea.indexOf(',',inicio);
if((i<5&&coma<0)||(i==5&&coma>=0)){
valido=false;
break;
}
String campo=(i<5)?linea.substring(inicio,coma):linea.substring(inicio);
campo.trim();
if(campo.length()==0){
valido=false;
break;
}
valores[i]=campo.toFloat();
inicio=coma+1;
}
if(!valido){
Serial.println("Formato incorrecto. Escriba seis valores separados por comas.");
return;
}
float X[7]={1,valores[0]/100.0,valores[1],valores[2]/40.0,valores[3]/10.0,valores[4]/4000.0,valores[5]};
float z=calcularZ(X);
int resultado=predecir(X);
Serial.print("Z = ");
Serial.println(z,8);
Serial.print("Obesidad = ");
Serial.println(resultado);
Serial.println("Resultado academico, no es un diagnostico medico.");
}
}
